## conf/bblayers.conf
```bitbake
# POKY_BBLAYERS_CONF_VERSION is increased each time build/conf/bblayers.conf
# changes incompatibly
POKY_BBLAYERS_CONF_VERSION = "2"

BBPATH = "${TOPDIR}"
BBFILES ?= ""

BBLAYERS ?= " \
  /ws/x15/sources/poky/meta \
  /ws/x15/sources/poky/meta-poky \
  /ws/x15/sources/poky/meta-yocto-bsp \
  /ws/x15/sources/meta-arm/meta-arm \
  /ws/x15/sources/meta-arm/meta-arm-toolchain \
  /ws/x15/sources/meta-ti/meta-ti-bsp \
  "
```
